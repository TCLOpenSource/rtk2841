## drivers/android/Kconfig
```kconfig
menu "Android"

config ANDROID
	bool "Android Drivers"
	---help---
	  Enable support for various drivers needed on the Android platform

if ANDROID

config ANDROID_VERSION
        int "Number of Android version"
	default 7
	help
		This option tell which android version use.

config USE_ANDROID_O_DRIVER
       bool "Use Drivers for Android Oreo"
       default n
       ---help---
      Newner kernel driver may not compatible for old Android.

      Select this to use drivers for Android O, otherwise,
      use drivers for Android N.

config ANDROID_BINDER_DEVICES
    string "Android Binder devices"
    depends on ANDROID_BINDER_IPC && USE_ANDROID_O_DRIVER
    default "binder,hwbinder,vndbinder"
    ---help---
      Default value for the binder.devices parameter.

      The binder.devices parameter is a comma-separated list of strings
      that specifies the names of the binder device nodes that will be
      created. Each binder device has its own context manager, and is
      therefore logically separated from the other devices.

config ANDROID_BINDER_IPC
	bool "Android Binder IPC Driver"
	depends on MMU
	default n
	---help---
	  Binder is used in Android for both communication between processes,
	  and remote method invocation.

	  This means one Android process can call a method/routine in another
	  Android process, using Binder to identify, invoke and pass arguments
	  between said processes.
	  
config ANDROID_BINDER_IPC_SELFTEST
	bool "Android Binder IPC Driver Selftest"
	depends on ANDROID_BINDER_IPC && USE_ANDROID_O_DRIVER
	---help---
	  This feature allows binder selftest to run.

	  Binder selftest checks the allocation and free of binder buffers
	  exhaustively with combinations of various buffer sizes and
	  alignments.

config ANDROID_BINDER_IPC_32BIT
	bool
	depends on !64BIT && ANDROID_BINDER_IPC
	default y
	---help---
	  The Binder API has been changed to support both 32 and 64bit
	  applications in a mixed environment.

	  Enable this to support an old 32-bit Android user-space (v4.4 and
	  earlier).

	  Note that enabling this will break newer Android user-space.

config ANDROID_TV
	bool "Android TV Drivers"
	default n
	---help---
	  Enable support for various drivers needed on the Android platform without TvServer

choice
        prompt "Android Version"
        default ANDROID_Nougat

config ANDROID_KITKAT
        bool "KitKat"
        help
          Used Android version is KitKat (4.4)

config ANDROID_LOLLIPOP
        bool "Lollipop"
        help
          Used Android version is Lollipop (5.x)

config ANDROID_MARSHNALLOW
        bool "Marshmallow"
        help
          Used Android version is Lollipop (6.x)

config ANDROID_Nougat
        bool "Nougat"
        help
          Used Android version is Nougat (7.x)

endchoice

endif # if ANDROID

endmenu
```

## drivers/clk/lg1k/Kconfig
```kconfig
config COMMON_CLK_LG1K
	tristate "Clock driver for LG1K SoCs"
	select LG1K_PMS
	---help---
	  This driver supports clocking subsystem on LG Electronics LG1k SoCs.
```

## drivers/i2c/algos/Kconfig
```kconfig
#
# I2C algorithm drivers configuration
#

menu "I2C Algorithms"
	visible if !I2C_HELPER_AUTO

config I2C_ALGOBIT
	tristate "I2C bit-banging interfaces"

config I2C_ALGOPCF
	tristate "I2C PCF 8584 interfaces"

config I2C_ALGOPCA
	tristate "I2C PCA 9564 interfaces"

config I2C_ALGORTK
	tristate "I2C Realtek interfaces"
	depends on I2C && I2C_RTK
	default n if ARCH_RTK289X || ARCH_RTK299O
	help
		Supports the Realtek I2C


endmenu
```

## drivers/misc/lg1k/Kconfig
```kconfig
config LG1K_PMS
	tristate "Generic interface driver for LG1K Power Management System"
	help
	  This option enables LG1K SoCs to register and to use possible
	  PMS(Power Management System) operations.
```

## drivers/net/ethernet/arasan/Kconfig
```kconfig
#
# Arasan device configuration
#

config NET_VENDOR_ARASAN
	bool "Arasan devices"
	default y
	---help---
	  If you have a network (Ethernet) card belonging to this class, say Y.
	  Make sure you know the name of your card. Read the Ethernet-HOWTO,
	  available from <http://www.tldp.org/docs.html#howto>.

	  If unsure, say Y.

	  Note that the answer to this question doesn't directly affect the
	  kernel: saying N will just cause the configurator to skip all
	  the remaining Atmel network card questions. If you say Y, you will be
	  asked for your specific card in the following questions.

if NET_VENDOR_ARASAN

config EMAC
	tristate "Arasan Fast Ethernet MAC support"
	select CRC32
	select PHYLIB
	---help---
	  Say Y here to support the Arasan Fast Ethernet MAC usually
	  found in LGE DTV SoCs.

	  To compile this driver as a module, choose M here: the module
	  will be called emac.

endif # NET_VENDOR_ARASAN
```

## drivers/net/wireless/realtek/rtlwifi/Kconfig
```kconfig
menuconfig RTL_CARDS
	tristate "Realtek rtlwifi family of devices"
	depends on MAC80211 && (PCI || USB)
	default y
	---help---
	  This option will enable support for the Realtek mac80211-based
	  wireless drivers. Drivers rtl8192ce, rtl8192cu, rtl8192se, rtl8192de,
	  rtl8723ae, rtl8723be, rtl8188ee, rtl8192ee, and rtl8821ae share
	  some common code.

if RTL_CARDS

config RTL8192CE
	tristate "Realtek RTL8192CE/RTL8188CE Wireless Network Adapter"
	depends on PCI
	select RTL8192C_COMMON
	select RTLWIFI
	select RTLWIFI_PCI
	---help---
	This is the driver for Realtek RTL8192CE/RTL8188CE 802.11n PCIe
	wireless network adapters.

	If you choose to build it as a module, it will be called rtl8192ce

config RTL8192SE
	tristate "Realtek RTL8192SE/RTL8191SE PCIe Wireless Network Adapter"
	depends on PCI
	select RTLWIFI
	select RTLWIFI_PCI
	---help---
	This is the driver for Realtek RTL8192SE/RTL8191SE 802.11n PCIe
	wireless network adapters.

	If you choose to build it as a module, it will be called rtl8192se

config RTL8192DE
	tristate "Realtek RTL8192DE/RTL8188DE PCIe Wireless Network Adapter"
	depends on PCI
	select RTLWIFI
	select RTLWIFI_PCI
	---help---
	This is the driver for Realtek RTL8192DE/RTL8188DE 802.11n PCIe
	wireless network adapters.

	If you choose to build it as a module, it will be called rtl8192de

config RTL8723AE
	tristate "Realtek RTL8723AE PCIe Wireless Network Adapter"
	depends on PCI
	select RTLWIFI
	select RTLWIFI_PCI
	select RTL8723_COMMON
	select RTLBTCOEXIST
	---help---
	This is the driver for Realtek RTL8723AE 802.11n PCIe
	wireless network adapters.

	If you choose to build it as a module, it will be called rtl8723ae

config RTL8723BE
	tristate "Realtek RTL8723BE PCIe Wireless Network Adapter"
	depends on PCI
	select RTLWIFI
	select RTLWIFI_PCI
	select RTL8723_COMMON
	select RTLBTCOEXIST
	---help---
	This is the driver for Realtek RTL8723BE 802.11n PCIe
	wireless network adapters.

	If you choose to build it as a module, it will be called rtl8723be

config RTL8188EE
	tristate "Realtek RTL8188EE Wireless Network Adapter"
	depends on PCI
	select RTLWIFI
	select RTLWIFI_PCI
	---help---
	This is the driver for Realtek RTL8188EE 802.11n PCIe
	wireless network adapters.

	If you choose to build it as a module, it will be called rtl8188ee

config RTL8192EE
	tristate "Realtek RTL8192EE Wireless Network Adapter"
	depends on PCI
	select RTLWIFI
	select RTLWIFI_PCI
	select RTLBTCOEXIST
	---help---
	This is the driver for Realtek RTL8192EE 802.11n PCIe
	wireless network adapters.

	If you choose to build it as a module, it will be called rtl8192ee

config RTL8821AE
	tristate "Realtek RTL8821AE/RTL8812AE Wireless Network Adapter"
	depends on PCI
	select RTLWIFI
	select RTLWIFI_PCI
	select RTLBTCOEXIST
	---help---
	This is the driver for Realtek RTL8821AE/RTL8812AE 802.11ac PCIe
	wireless network adapters.

	If you choose to build it as a module, it will be called rtl8821ae

config RTL8192CU
	tristate "Realtek RTL8192CU/RTL8188CU USB Wireless Network Adapter"
	depends on USB
	select RTLWIFI
	select RTLWIFI_USB
	select RTL8192C_COMMON
	---help---
	This is the driver for Realtek RTL8192CU/RTL8188CU 802.11n USB
	wireless network adapters.

	If you choose to build it as a module, it will be called rtl8192cu

config RTL8192DU
	tristate "Realtek 8192D USB WiFi"
	depends on USB
	select RTLWIFI
	select RTLWIFI_USB
	select WIRELESS_EXT
	select WEXT_PRIV
	---help---
	  Help message of RTL8192DU

config RTL8192EU
        tristate "Realtek 8192E USB WiFi"
        depends on USB
        ---help---
          Help message of RTL8192EU

config RTL8188EU
	tristate "Realtek 8188E USB WiFi"
	depends on USB
	---help---
	  Help message of RTL8188EU

config RTL8188FU
	tristate "Realtek 8188F USB WiFi"
	depends on USB
	---help---
	  Help message of RTL8188FU

config RTL8812AU
	tristate "Realtek 8812AU/8821AU USB WiFi"
	depends on USB
	---help---
	  Help message of RTL8821AU

config RTL8814AU
	tristate "Realtek 8814A USB WiFi"
	depends on USB
	---help---
	  Help message of RTL8814AU

config RTL8723BU
	tristate "Realtek 8723B USB WiFi"
	depends on USB
	---help---
	  Help message of RTL8723BU

config RTL8822BU
	tristate "Realtek 8822B USB WiFi"
	depends on USB
	---help---
	  Help message of RTL8822BU

config RTL8821AU
        tristate "Realtek 8821A USB WiFi"
        depends on USB
        ---help---
          Help message of RTL8821AU

config RTLWIFI
	tristate
	select FW_LOADER

config RTLWIFI_PCI
	tristate

config RTLWIFI_USB
	tristate

config RTLWIFI_DEBUG
	bool "Debugging output for rtlwifi driver family"
	depends on RTLWIFI
	default y
	---help---
	To use the module option that sets the dynamic-debugging level for,
	the front-end driver, this parameter must be "Y". For memory-limited
	systems, choose "N". If in doubt, choose "Y".

config RTL8192C_COMMON
	tristate
	depends on RTL8192CE || RTL8192CU
	default y

config RTL8723_COMMON
	tristate
	depends on RTL8723AE || RTL8723BE
	default y

config RTLBTCOEXIST
	tristate
	depends on RTL8723AE || RTL8723BE || RTL8821AE || RTL8192EE
	default y

config RTK_CUSTOMER_TV002
	bool "enable wowlan function for tv002 customer"
	default n
	---help---
	  Enable WOWLAN for tv002 customer
endif
```
