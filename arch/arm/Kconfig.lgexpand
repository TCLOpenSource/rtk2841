## arch/arm/mach-lg115x/Kconfig
```kconfig
menu "LG115x options"
	depends on ARCH_LG115X

choice
	prompt "LG115x system type"

config MACH_LG1152
	bool "LG1152-based board"
	select HAVE_ARM_SCU if SMP
	select HAVE_ARM_TWD if LOCAL_TIMERS
	select MIGHT_HAVE_CACHE_L2X0
	select USB_ARCH_HAS_EHCI
	select USB_ARCH_HAS_OHCI
	select ARCH_HIBERNATION_POSSIBLE
	help
	  Include support for the LG1152(AKA L9)-based board.

config MACH_LG1154
	bool "LG1154-based board"
	select HAVE_ARM_SCU if SMP
	select HAVE_ARM_TWD if LOCAL_TIMERS
	select MIGHT_HAVE_CACHE_L2X0
	select USB_ARCH_HAS_EHCI
	select USB_ARCH_HAS_OHCI
	select USB_ARCH_HAS_XHCI
	select USB_XHCI_PLATFORM
	select ARCH_HIBERNATION_POSSIBLE
	select CLOCK_DETECTION
	select COMMON_CLK_LG1K
	help
	  Include support for the LG1154(AKA H13)-based board.

config MACH_LG1156
	bool "LG1156-based board"
	select USB_ARCH_HAS_XHCI
	select USB_XHCI_PLATFORM
	help
	  Include support for the LG1156(AKA H14)-based board.

endchoice

choice
	prompt "LG1152 chip revision"
	depends on MACH_LG1152

config LG1152_B0
	bool "LG1152 B0"
	select ARM_ERRATA_754322
	select ARM_ERRATA_764369
	select PL310_ERRATA_727915
	select PL310_ERRATA_753970
	select PL310_ERRATA_769419
	help
	  Cortex-A9 MPcore revision: r2p9
	  PL310 L2 Cache Controller revision: r3p0

endchoice

choice
	prompt "LG1154 chip revision"
	depends on MACH_LG1154

config LG1154_A0
	bool "LG1154 A0"
	select ARM_ERRATA_754322
	select ARM_ERRATA_764369
	help
	  Cortex-A9 MPcore revision: r3p0
	  PL310 L2 Cache Controller revision: r3p2

config LG1311_A0
	bool "LG1311 A0"
	select ARM_ERRATA_754322
	select ARM_ERRATA_764369
	help
	  Cortex-A9 MPcore revision: r3p0
	  PL310 L2 Cache Controller revision: r3p2

endchoice

choice
	prompt "LG1156 chip revision"
	depends on MACH_LG1156

config LG1156_A0
	bool "LG1156 A0"
	help
	  Cortex-A15 MPcore revision: r3p1

endchoice

config CLOCK_DETECTION
	bool

comment "Clocks and timers"

config AMBA_CLOCK_MHZ
	int "AMBA bus clock frequency (MHz)"
	default 198

config PERI_CLOCK_MHZ
	int "MPcore peripheral clock frequency (MHz)"
	default 396
	depends on LOCAL_TIMERS && !CLOCK_DETECTION

config PERI_CLOCK_ADJ
	int "MPcore peripheral clock frequency adjustment (Hz)"
	default 0
	depends on LOCAL_TIMERS && !CLOCK_DETECTION
	help
	  Use this value for fine-tuning.

config SP804_CLOCKSOURCE_PRESET
	bool "Use preset mult/shift for the clocksource using SP804"
	default y

config SP804_CLOCKSOURCE_PRESET_MULT
	int "Preset mult"
	default 2711573867
	depends on SP804_CLOCKSOURCE_PRESET

config SP804_CLOCKSOURCE_PRESET_SHIFT
	int "Preset shift"
	default 29
	depends on SP804_CLOCKSOURCE_PRESET

comment "Level-2 cache controller options"

config L2CC_ECC
	bool "Enable L2 ECC and parity"
	default y
	depends on MACH_LG1156
	help
	  Enable L2-cache ECC and parity implemented in Cortex-A15 MPcore.

config L2CC_LATENCY_TAG
	hex "Intenal tag-RAM latency"
	default 0x333
	depends on CACHE_L2X0
	help
	  [10: 8] RAM write access latency
	  [ 6: 4] RAM read access latency
	  [ 2: 0] RAM setup latency
	  b000 = 1 cycle of latency, there is no additional latency.
	  b001 = 2 cycles of latency.
	  b010 = 3 cycles of latency.
	  b011 = 4 cycles of latency.
	  b100 = 5 cycles of latency.
	  b101 = 6 cycles of latency.
	  b110 = 7 cycles of latency.
	  b111 = 8 cycles of latency.

config L2CC_LATENCY_DATA
	hex "Internal data-RAM latency"
	default 0x333
	depends on CACHE_L2X0
	help
	  [10: 8] RAM write access latency
	  [ 6: 4] RAM read access latency
	  [ 2: 0] RAM setup latency
	  b000 = 1 cycle of latency, there is no additional latency.
	  b001 = 2 cycles of latency.
	  b010 = 3 cycles of latency.
	  b011 = 4 cycles of latency.
	  b100 = 5 cycles of latency.
	  b101 = 6 cycles of latency.
	  b110 = 7 cycles of latency.
	  b111 = 8 cycles of latency.

config L2CC_PREFETCH_DATA
	bool "Enable data-prefetch"
	default n
	depends on CACHE_L2X0

config L2CC_PREFETCH_INST
	bool "Enable instruction-prefetch"
	default n
	depends on CACHE_L2X0

config L2CC_PREFETCH_OFFSET
	int "Prefetch-offset (0-7, 15, 23, 31)"
	default 0
	depends on CACHE_PL310 && (L2CC_PREFETCH_DATA || L2CC_PREFETCH_INST)
	help
	  In some systems, it might be better to prefetch more in advance
	  to achieve better performance. The prefetch offset enables this
	  by setting the address of the prefetched cache line to
	  Cache Line + 1 + Offset. The optimal value of the prefetch offset
	  depends on the L3 read latency and on the L1 read issuing capability.
	  It is recommended to perform system experiments by varying
	  the prefetch offset, to find the optimal value.

config L2CC_DEBUG_DCL
	bool "DCL: Disable Cache Linefill"
	default n
	depends on CACHE_L2X0
	help
	  If you set the DCL bit to 1, no allocation occurs on either reads or
	  writes. This mode of operation is required for debug so that the
	  memory image, as seen by the processor, can be examined in a
	  non-invasive manner. Cache hits read data words from the cache, and
	  cache misses from a cacheable region read words directly from memory.

config L2CC_DEBUG_DWB
	bool "DWB: Diable Write-Back (force write-through)"
	default n
	depends on CACHE_L2X0
	help
	  If you set the DWB bit to 1, it forces the cache controller to treat
	  all cacheable writes as though they were in a write-through no write-
	  allocate region of memory. The setting of the DWB bit overrides the
	  access attributes. If the cache contains dirty cache lines, these
	  remain dirty while the DWB bit is set, unless they are written back
	  because of a write-back eviction after a linefill, or because of an
	  explicit clean operation.
	  While the DWB bit is set, lines that are clean are not marked as
	  dirty if they are updated. This functionality enables a debugger to
	  download code or data to external memory, without the requirement to
	  clean part or the entire cache to ensure that the code or data being
	  downloaded has been written to external memory.
	  If you have set the DWB bit to 1, and a write is made to a cache line
	  that is dirty, then both the cache line and the external memory are
	  updated with the write data.

comment "Ethernet MAC/PHY options"

choice
	prompt "GPIO used to cold-reset Ethernet PHY"

config EPHY_RESET_GPIO27
	bool "GPIO27"

config EPHY_RESET_GPIO29
	bool "GPIO29"

endchoice

comment "Miscellaneous options"

config ARCH_HIBERNATION_POSSIBLE
	def_bool n

endmenu
```

## arch/arm/mach-lg1k/Kconfig
```kconfig
menu "LG1xxx options"
	depends on ARCH_LG1K

comment "LG1xxx system type"

config ARCH_LG1K_CA9MPCORE
	bool "LG1xxx based on Cortex-A9 MPcore"
	select HAVE_ARM_SCU if SMP
	select HAVE_ARM_TWD if SMP
	select MIGHT_HAVE_CACHE_L2X0
	select USB_ARCH_HAS_EHCI
	select USB_ARCH_HAS_OHCI
	select USB_ARCH_HAS_XHCI
	select USB_XHCI_PLATFORM
	select COMMON_CLK_LG1K
	select LG1K_PMS

config ARCH_LG1K_CA15MPCORE
	bool "LG1xxx based on Cortex-A15 MPcore"
	select ARM_ARCH_TIMER if SMP
	select USB_ARCH_HAS_XHCI
	select USB_XHCI_PLATFORM
	select COMMON_CLK_LG1K
	select REGULATOR_LG1K
	select LG1K_PMS

comment "Clocks and timers"

config AMBA_CLOCK_MHZ
	int "AMBA bus clock frequency (MHz)"
	default 198

comment "Level-2 cache controller options"

if MIGHT_HAVE_CACHE_L2X0

config L2CC_PREFETCH_DATA
	bool "Enable data-prefetch"
	default n
	depends on CACHE_L2X0

config L2CC_PREFETCH_INST
	bool "Enable instruction-prefetch"
	default n
	depends on CACHE_L2X0

config L2CC_PREFETCH_OFFSET
	int "Prefetch-offset (0-7, 15, 23, 31)"
	default 0
	depends on CACHE_PL310 && (L2CC_PREFETCH_DATA || L2CC_PREFETCH_INST)
	help
	  In some systems, it might be better to prefetch more in advance
	  to achieve better performance. The prefetch offset enables this
	  by setting the address of the prefetched cache line to
	  Cache Line + 1 + Offset. The optimal value of the prefetch offset
	  depends on the L3 read latency and on the L1 read issuing capability.
	  It is recommended to perform system experiments by varying
	  the prefetch offset, to find the optimal value.

endif	# MIGHT_HAVE_CACHE_L2X0

comment "Miscellaneous options"

config ARCH_HIBERNATION_POSSIBLE
	def_bool y

endmenu
```

## arch/arm/mach-rtd284x/Kconfig
```kconfig
if ARCH_RTK284X

menu "RTK284X specific features"
	depends on ARCH_RTK284X

config REALTEK_FPGA
	bool "Support Realtek FPGA"
	default n

config REALTEK_2K_MODEL_ENABLED
        bool "Enable 2K-model"
        default n
        help
                If your project is 2K-model, please select it

config REALTEK_SECURE
	bool "Enable Secure Solution"
	default n
	help
		Provide realtek secure solution.
config REALTEK_RESCUE_LINUX
	bool "Rescue Linux"
	default n

config REALTEK_POWER_CUT
        bool "Enable Realtek Power Cut"
        default n

config REALTEK_SECURE_OS
	bool "Enable Secure OS"
	default n
	help
		If you want build secure OS, please select it

config REALTEK_DEV_MEM
	bool "Provide the /dev/rtkmem interface."
	default n
	help
		Provide an interface to replace /dev/mem.

config REALTEK_MANAGE_OVERLAPPED_REGION
        bool "Manage the memory region overlapped by RBUS & NOR."
        default n
        help
          Put the memory region overlapped by RBUS & NOR under the control of linux.

config REALTEK_PCBMGR
	bool "Use Realtek PCB Manager sysfs"
	default n
	help
		pcb manager enable, pcb manager will export the pcb info at /sys/realtek_boards/pcb_enum

config REALTEK_ARM_WRAPPER
	bool "ARM WRAPPER Detector Enable"
	default n
	help
	  support ARM WRAPPER Detector

config REALTEK_KEYPAD
	bool "keypad"
	default n
	help
	  support keypad device

config MHL_INT_SUPPORT
	bool "Realtek MHL Cbus interrupt"
	default y

config REALTEK_SCHED_LOG
	bool "Log the scheduling sequence."
	default y
	help
	  Log the scheduling sequence.

config ANDROID_SW_RENDER
        bool "Support Android software rendering"
        default n
        help
                If android bringup without ddk, this should be enabled.

#Recovery kernel
config RTK_KDRV_RECOVERY_KERNEL
	bool "Build for android rescue kernel"
	default n
	help
	  Android rescue kernel for Realtek

endmenu

source "drivers/rtk_kdriver/Kconfig"

endif
```

## arch/arm/mm/Kconfig.kasan
```kconfig
menu "Kernel Address Sanitizer support"
	depends on KASAN

config KASAN_SHADOW_OFFSET
	hex "KASan shadow memory offset"
	---help---
	  It must be calculated as "KASAN_SHADOW_VIRT - (MODULES_VADDR >>
	  KASAN_SHADOW_SCALE_SHIFT)."

config KASAN_SHADOW_PHYS
	hex "Physical address to KASan shadow memory"
	---help---
	  It must be an 1MB-aligned physical address to normal memory.

config KASAN_SHADOW_VIRT
	hex "Virtual address to KASan shadow memory"
	---help---
	  Currently, the KASan shadow memory should be reside within
	  the vmalloc area. It must be an 1MB-aligned address.

config KASAN_SHADOW_SIZE
	hex "Size of KASan shadow memory"
	---help---
	  Needed size of the KASan shadow memory can be calculated as
	  "(lowmem_size + 16MB) >> KASAN_SHADOW_SCALE_SHIFT." It must
	  be an 1MB-aligned size.

endmenu
```

## arch/arm64/configs/realtek/config.rescue.rtd289x64.old_defconfig
```kconfig
CONFIG_CROSS_COMPILE="asdk64-linux-"
# CONFIG_LOCALVERSION_AUTO is not set
# CONFIG_SWAP is not set
CONFIG_SYSVIPC=y
CONFIG_AUDIT=y
CONFIG_IRQ_DOMAIN_DEBUG=y
CONFIG_NO_HZ=y
CONFIG_HIGH_RES_TIMERS=y
CONFIG_BSD_PROCESS_ACCT=y
CONFIG_IKCONFIG=y
CONFIG_IKCONFIG_PROC=y
CONFIG_LOG_BUF_SHIFT=16
CONFIG_CGROUPS=y
CONFIG_CGROUP_FREEZER=y
CONFIG_BLK_DEV_INITRD=y
CONFIG_INITRAMFS_SOURCE="./rootfs"
CONFIG_INITRAMFS_ROOT_UID=16783985
CONFIG_INITRAMFS_ROOT_GID=16777729
# CONFIG_RD_BZIP2 is not set
# CONFIG_RD_LZMA is not set
# CONFIG_RD_XZ is not set
# CONFIG_RD_LZO is not set
# CONFIG_RD_LZ4 is not set
CONFIG_CC_OPTIMIZE_FOR_SIZE=y
CONFIG_KALLSYMS_ALL=y
CONFIG_EMBEDDED=y
CONFIG_MODULES=y
CONFIG_MODULE_FORCE_LOAD=y
CONFIG_MODULE_UNLOAD=y
CONFIG_MODULE_FORCE_UNLOAD=y
CONFIG_MODVERSIONS=y
CONFIG_MODULE_SRCVERSION_ALL=y
# CONFIG_BLK_DEV_BSG is not set
CONFIG_PARTITION_ADVANCED=y
# CONFIG_EFI_PARTITION is not set
CONFIG_ARCH_RTK289X=y
CONFIG_REALTEK_MANAGE_OVERLAPPED_REGION=y
CONFIG_REALTEK_PCBMGR=y
# CONFIG_MHL_INT_SUPPORT is not set
# CONFIG_REALTEK_SCHED_LOG is not set
# CONFIG_RTK_KDRV_EMCU is not set
CONFIG_RTK_KDRV_SB2=y
CONFIG_RTK_KDRV_GPIO=y
CONFIG_RTK_KDRV_PINMUX=y
CONFIG_RTK_KDRV_RTICE=y
# CONFIG_RTK_KDRV_RTICE_I2C_TOOL is not set
# CONFIG_RTK_KDRV_RTICE_AP_TOOL is not set
# CONFIG_RTK_KDRV_RTICE_BW_CHECK is not set
CONFIG_RTK_KDRV_SE=y
CONFIG_RTK_KDRV_GDMA=y
CONFIG_PREEMPT=y
# CONFIG_COMPACTION is not set
CONFIG_CMA=y
CONFIG_CMA_DEBUGFS=y
CONFIG_BUILD_ARM_APPENDED_DTB_IMAGE_EXT=y
CONFIG_BUILD_ARM_APPENDED_DTB_IMAGE_NAMES_EXT="rtd289x.dtb"
CONFIG_ARM_ATAG_DTB_COMPAT_EXT=y
CONFIG_CMDLINE="mem=256M console=ttyS0,115200 earlyprintk"
CONFIG_BINFMT_MISC=y
CONFIG_COMPAT=y
CONFIG_PM_DEBUG=y
CONFIG_NET=y
CONFIG_PACKET=y
CONFIG_UNIX=y
CONFIG_UNIX_DIAG=y
CONFIG_INET=y
CONFIG_IP_MULTICAST=y
CONFIG_IP_ADVANCED_ROUTER=y
CONFIG_IP_FIB_TRIE_STATS=y
CONFIG_IP_MULTIPLE_TABLES=y
CONFIG_IP_ROUTE_MULTIPATH=y
CONFIG_IP_PNP=y
CONFIG_BRIDGE=y
# CONFIG_WIRELESS is not set
CONFIG_DEVTMPFS=y
CONFIG_DEVTMPFS_MOUNT=y
CONFIG_DMA_CMA=y
CONFIG_MTD=y
CONFIG_REALTEK_OF=y
CONFIG_OF_OVERLAY=y
CONFIG_BLK_DEV_LOOP=y
CONFIG_BLK_DEV_RAM=y
CONFIG_BLK_DEV_RAM_SIZE=16384
CONFIG_SCSI=y
# CONFIG_SCSI_PROC_FS is not set
CONFIG_BLK_DEV_SD=y
CONFIG_CHR_DEV_SG=y
CONFIG_SCSI_SCAN_ASYNC=y
CONFIG_NETDEVICES=y
# CONFIG_NET_CADENCE is not set
# CONFIG_NET_VENDOR_BROADCOM is not set
# CONFIG_NET_VENDOR_INTEL is not set
# CONFIG_NET_VENDOR_MARVELL is not set
# CONFIG_NET_VENDOR_MICREL is not set
# CONFIG_NET_VENDOR_NATSEMI is not set
CONFIG_ETHOC=y
# CONFIG_NET_VENDOR_SMSC is not set
# CONFIG_NET_VENDOR_STMICRO is not set
# CONFIG_NET_VENDOR_WIZNET is not set
# CONFIG_WLAN is not set
# CONFIG_INPUT_MOUSEDEV_PSAUX is not set
CONFIG_INPUT_MOUSEDEV_SCREEN_X=1280
CONFIG_INPUT_MOUSEDEV_SCREEN_Y=720
CONFIG_INPUT_JOYDEV=y
CONFIG_INPUT_EVDEV=y
# CONFIG_INPUT_MOUSE is not set
CONFIG_INPUT_MISC=y
CONFIG_INPUT_UINPUT=y
# CONFIG_VT is not set
CONFIG_DEVPTS_MULTIPLE_INSTANCES=y
# CONFIG_LEGACY_PTYS is not set
CONFIG_SERIAL_8250=y
CONFIG_SERIAL_8250_CONSOLE=y
CONFIG_SERIAL_8250_NR_UARTS=32
CONFIG_SERIAL_8250_RUNTIME_UARTS=2
CONFIG_SERIAL_8250_EXTENDED=y
CONFIG_SERIAL_8250_MANY_PORTS=y
CONFIG_SERIAL_8250_SHARE_IRQ=y
CONFIG_SERIAL_8250_DETECT_IRQ=y
CONFIG_SERIAL_8250_RSA=y
# CONFIG_HW_RANDOM is not set
# CONFIG_I2C_COMPAT is not set
# CONFIG_I2C_HELPER_AUTO is not set
# CONFIG_HWMON is not set
CONFIG_REGULATOR=y
CONFIG_DRM=y
CONFIG_BACKLIGHT_LCD_SUPPORT=y
CONFIG_BACKLIGHT_CLASS_DEVICE=y
CONFIG_HIDRAW=y
CONFIG_USB=y
CONFIG_USB_XHCI_HCD=y
CONFIG_USB_XHCI_PLATFORM=y
CONFIG_USB_STORAGE=y
CONFIG_MMC=y
CONFIG_MMC_BLOCK_MINORS=16
CONFIG_MMC_RTKEMMC_PLUS=y
CONFIG_MMC_RTKEMMC_SHOW_EXTCSD=y
CONFIG_MMC_RTKEMMC_HK_ATTR=y
CONFIG_MMC_RTKEMMC_VENDOR_IOCTL=y
CONFIG_STAGING=y
CONFIG_ASHMEM=y
# CONFIG_ANDROID_TIMED_OUTPUT is not set
CONFIG_MAILBOX=y
CONFIG_ANDROID=y
# CONFIG_LG_BUILTIN_KDRIVER is not set
CONFIG_EXT2_FS=y
CONFIG_EXT4_FS=y
CONFIG_EXT4_FS_POSIX_ACL=y
CONFIG_EXT4_FS_SECURITY=y
CONFIG_MSDOS_FS=y
CONFIG_VFAT_FS=y
CONFIG_NTFS_FS=y
CONFIG_NTFS_RW=y
CONFIG_TMPFS=y
CONFIG_SQUASHFS=y
CONFIG_SQUASHFS_XATTR=y
CONFIG_SQUASHFS_LZO=y
CONFIG_SQUASHFS_XZ=y
CONFIG_SQUASHFS_4K_DEVBLK_SIZE=y
CONFIG_SQUASHFS_EMBEDDED=y
CONFIG_NFS_FS=y
CONFIG_NFS_V4=y
CONFIG_CIFS=y
# CONFIG_CIFS_DEBUG is not set
CONFIG_NLS_CODEPAGE_437=y
CONFIG_NLS_ISO8859_1=y
CONFIG_NLS_UTF8=y
CONFIG_PRINTK_TIME=y
CONFIG_DYNAMIC_DEBUG=y
CONFIG_DEBUG_INFO=y
CONFIG_DEBUG_FS=y
CONFIG_MAGIC_SYSRQ=y
CONFIG_SCHEDSTATS=y
CONFIG_TIMER_STATS=y
CONFIG_DEBUG_MUTEXES=y
# CONFIG_FTRACE is not set
CONFIG_SECURITY=y
CONFIG_SECURITYFS=y
CONFIG_SECURITY_NETWORK=y
CONFIG_CRYPTO_CBC=y
CONFIG_CRYPTO_MICHAEL_MIC=y
CONFIG_CRYPTO_DEFLATE=y
CONFIG_CRYPTO_LZO=y
CONFIG_CRC_CCITT=y
CONFIG_CRC_T10DIF=y
CONFIG_CRC_ITU_T=y
CONFIG_CRC7=y
CONFIG_LIBCRC32C=y
```
