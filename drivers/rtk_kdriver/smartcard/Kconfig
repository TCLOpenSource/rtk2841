## drivers/rtk_kdriver/smartcard/Kconfig
```kconfig
# drivers/cec/Kconfig

menu "Smart Card Interface Support"

config RTK_KDRV_SMARTCARD
	tristate "Smart Card Interface Support"
	default n
	help
	  Say Y here if you want to support smart card on your platform

source drivers/rtk_kdriver/smartcard/core/Kconfig
source drivers/rtk_kdriver/smartcard/adapter/Kconfig

endmenu
```

## drivers/rtk_kdriver/smartcard/adapter/Kconfig
```kconfig
# drivers/Kconfig

comment"Smart Card Interface"
	depends on RTK_KDRV_SMARTCARD

config RTK_KDRV_SMARTCARD_IFD
	tristate "Realtek  Smart Card Interface"
	depends on RTK_KDRV_SMARTCARD 
	select RTK_KDRV_GPIO
	default n
	help
	  If you want to use smart card on board, say Y.
```

## drivers/rtk_kdriver/smartcard/core/Kconfig
```kconfig
# drivers/smartcard/core/Kconfig

config RTK_KDRV_SMARTCARD_CHARDEV
	bool "Smart Card Device Interface"
	depends on RTK_KDRV_SMARTCARD
	select RTK_KDRV_SMARTCARD_DEV_FILE
	help
	  Say Y here to use smart card device files, usually found in the /dev/smartcard/
	  directory on your system.  They make it possible to have user-space
	  programs use the smart card reader.

config RTK_KDRV_SMARTCARD_DEV_FILE
	bool 
	depends on RTK_KDRV_SMARTCARD
	default n

config RTK_KDRV_SMARTCARD_DEBUG
	bool "Smart Card Debug Mode"
	depends on RTK_KDRV_SMARTCARD
	default n
	help
	  If you want to enable smart card debug message, say Y.
```

## drivers/rtk_kdriver/switch/Kconfig
```kconfig
#Copyright (C) 2007-2013 Realtek Semiconductor Corporation.
# drivers/rtk_kdriver/switch/Kconfig

config RTK_KDRV_SWITCH
	bool "Switch Support"

config RTK_KDRV_SWITCH_GPIO
	bool "GPIO Switch  device interface"
	depends on RTK_KDRV_SWITCH
	help
	  GPIO Switch Device Driver
```

## drivers/rtk_kdriver/teeproxy/Kconfig
```kconfig
config RTK_KDRV_TEEPROXY
	bool "Driver for TeeProxy"
	depends on RTK_KDRV_RPC
	default n
	help
	  Driver for TeeProxy
```

## drivers/rtk_kdriver/thermal/Kconfig
```kconfig
menu "Realtek Thermal Support"

if THERMAL
config RTK_KDRV_THERMAL
    depends on RTK_KDRIVER_SUPPORT
    select RTK_KDRIVER
    tristate "Realtek thermal management"
	    help
		      Enable this option if you want to have support for thermal management
			        controller present in Realtek SoC.
			          	
config RTK_KDRV_THERMAL_GOV_RTK_THERMAL_THROTTLE
       depends on RTK_KDRV_THERMAL
       bool "Realtek thermal governor"
       help
	Enable this to manage platform thermals using fair-share governor.	
endif

config RTK_KDRV_THERMAL_DEFAULT_GOV_RTK_THERMAL
			 depends on RTK_KDRV_THERMAL_GOV_RTK_THERMAL_THROTTLE 
       bool "Realtek default thermal governor"
       help
         Use the rtk_thermal governor as default. This throttles the
         devices depends on temperature 

#Thermal Sensor
config RTK_KDRV_THERMAL_SENSOR
	bool "Thermal Sensor Driver."
	depends on RTK_KDRIVER_SUPPORT
	select RTK_KDRIVER
	default n
	help
	  Thermal Sensor

config RTK_KDRV_ENABLE_THERMAL_CALLBACK
    depends on RTK_KDRV_THERMAL
    default n
    bool "Realtek Thermal callback mesachism"
	    help
		      Enable the callback mesachism of thermal.
endmenu
```

## drivers/rtk_kdriver/tp/Kconfig
```kconfig
config RTK_KDRV_TP
	bool "TP Driver (MPEG2-Transport)"
	select RTK_KDRV_CW
	depends on RTK_KDRIVER_SUPPORT
	default n		  

config RTK_KDRV_MULTI_TP_CLOCK
	bool "Enable multiple tp clock"
	depends on RTK_KDRV_TP
	default y if RTK_KDRV_TP
	help
		Enable multiple tp clock.
```

## drivers/rtk_kdriver/tvscalercontrol/Kconfig
```kconfig
config SUPPORT_SCALER
	bool "Scaler Driver"
	default n
	help
		SUPPORT Scaler Driver

if SUPPORT_SCALER
config ENABLE_3D_SETTING
	bool "Enable VDC 3D YC Separation"
	default y
	help
		3D YC Separation

config DYNAMIC_ALLOCATION_SCALER_MEMORY
	bool "Enable dynamic memory allocation"
	default y
	help
		SUPPORT memory dynamic allocation

config DUAL_CHANNEL
	bool "Enable dual channel"
	default y
	help
		dual chanel open for pip


config ENABLE_VD_27MHZ_MODE
	bool "Enable VD 27MHz mode"
	default y
	help
		enable VD 27MHz mode

config FIX_CKILL_MODE
	bool "Fix ckill mode"
	default y
	help
		Fix ckill mode

config ENABLE_DOLBY_VISION_HDMI_AUTO_DETECT
	bool "Enable Dolby Vision HDMI Auto Detect"
	default n
	help
		Enable Dolby Vision HDMI Auto Detect

config ENABLE_HDR10_HDMI_AUTO_DETECT
	bool "Enable HDR10 HDMI Auto Detect"
	default n
	help
		Enable HDR10 HDMI Auto Detect


config HDMI_DRV_CONTROL_AVMUTE
	bool "Enable HDMI CONTROL AVMUTE"
	default n
	help
		Enable HDMI CONTROL AVMUTE
endif

config MEMC
    bool "Enable MEMC"
    default n
    help
        Provide realtek MEMC.

config SCALER_MDOMAIN
    bool "Enable SCALER_MDOMAIN"
    default n
    help
        Provide realtek SCALER_MDOMAIN.
```

## drivers/rtk_kdriver/uart/Kconfig
```kconfig
menu "Realtek Uart Driver Support"

config RTK_KDRV_SERIAL_8250
	tristate "8250/16550 and compatible serial support"
	select SERIAL_CORE
	---help---
	  This selects whether you want to include the driver for the standard
	  serial ports.  The standard answer is Y.  People who might say N
	  here are those that are setting up dedicated Ethernet WWW/FTP
	  servers, or users that have one of the various bus mice instead of a
	  serial mouse and don't intend to use their machine's standard serial
	  port for anything.  (Note that the Cyclades multi serial port driver
	  does not need this driver built in for it to work.)

	  To compile this driver as a module, choose M here: the
	  module will be called 8250.
	  [WARNING: Do not compile this driver as a module if you are using
	  non-standard serial ports, since the configuration information will
	  be lost when the driver is unloaded.  This limitation may be lifted
	  in the future.]

	  BTW1: If you have a mouseman serial mouse which is not recognized by
	  the X window system, try running gpm first.

	  BTW2: If you intend to use a software modem (also called Winmodem)
	  under Linux, forget it.  These modems are crippled and require
	  proprietary drivers which are only available under Windows.

	  Most people will say Y or M here, so that they can use serial mice,
	  modems and similar devices connecting to the standard serial ports.
	  
config RTK_KDRV_SERIAL_8250_DEPRECATED_OPTIONS
	bool "Support 8250_core.* kernel options (DEPRECATED)"
	depends on RTK_KDRV_SERIAL_8250
	default y
	---help---
	  In 3.7 we renamed 8250 to 8250_core by mistake, so now we have to
	  accept kernel parameters in both forms like 8250_core.nr_uarts=4 and
	  8250.nr_uarts=4. We now renamed the module back to 8250, but if
	  anybody noticed in 3.7 and changed their userspace we still have to
	  keep the 8250_core.* options around until they revert the changes
	  they already did.

	  If 8250 is built as a module, this adds 8250_core alias instead. 

	  If you did not notice yet and/or you have userspace from pre-3.7, it
	  is safe (and recommended) to say N here.
	  
config RTK_KDRV_SERIAL_8250_EXTENDED
	bool "Extended 8250/16550 serial driver options"
	depends on RTK_KDRV_SERIAL_8250
	help
	  If you wish to use any non-standard features of the standard "dumb"
	  driver, say Y here. This includes HUB6 support, shared serial
	  interrupts, special multiport support, support for more than the
	  four COM 1/2/3/4 boards, etc.

	  Note that the answer to this question won't directly affect the
	  kernel: saying N will just cause the configurator to skip all
	  the questions about serial driver options. If unsure, say N.
	  
config RTK_KDRV_SERIAL_8250_CONSOLE
	bool "Console on 8250/16550 and compatible serial port"
	depends on RTK_KDRV_SERIAL_8250=y
	select SERIAL_CORE_CONSOLE
	select SERIAL_EARLYCON
	---help---
	  If you say Y here, it will be possible to use a serial port as the
	  system console (the system console is the device which receives all
	  kernel messages and warnings and which allows logins in single user
	  mode). This could be useful if some terminal or printer is connected
	  to that serial port.

	  Even if you say Y here, the currently visible virtual console
	  (/dev/tty0) will still be used as the system console by default, but
	  you can alter that using a kernel command line option such as
	  "console=ttyS1". (Try "man bootparam" or see the documentation of
	  your boot loader (grub or lilo or loadlin) about how to pass options
	  to the kernel at boot time.)

	  If you don't have a VGA card installed and you say Y here, the
	  kernel will automatically use the first serial line, /dev/ttyS0, as
	  system console.

	  You can set that using a kernel command line option such as
	  "console=uart8250,io,0x3f8,9600n8"
	  "console=uart8250,mmio,0xff5e0000,115200n8".
	  and it will switch to normal serial console when the corresponding
	  port is ready.
	  "earlycon=uart8250,io,0x3f8,9600n8"
	  "earlycon=uart8250,mmio,0xff5e0000,115200n8".
	  it will not only setup early console.

	  If unsure, say N.	  

config RTK_KDRV_SERIAL_8250_NR_UARTS
	int "Maximum number of 8250/16550 serial ports"
	depends on RTK_KDRV_SERIAL_8250
	default "4"
	help
	  Set this to the number of serial ports you want the driver
	  to support.  This includes any ports discovered via ACPI or
	  PCI enumeration and any ports that may be added at run-time
	  via hot-plug, or any ISA multi-port serial cards.

config RTK_KDRV_SERIAL_8250_RUNTIME_UARTS
	int "Number of 8250/16550 serial ports to register at runtime"
	depends on RTK_KDRV_SERIAL_8250
	range 0 RTK_KDRV_SERIAL_8250_NR_UARTS
	default "4"
	help
	  Set this to the maximum number of serial ports you want
	  the kernel to register at boot time.  This can be overridden
	  with the module parameter "nr_uarts", or boot-time parameter
	  8250.nr_uarts
	  
config RTK_KDRV_SERIAL_8250_MANY_PORTS
	bool "Support more than 4 legacy serial ports"
	depends on RTK_KDRV_SERIAL_8250_EXTENDED && !IA64
	help
	  Say Y here if you have dumb serial boards other than the four
	  standard COM 1/2/3/4 ports. This may happen if you have an AST
	  FourPort, Accent Async, Boca (read the Boca mini-HOWTO, available
	  from <http://www.tldp.org/docs.html#howto>), or other custom
	  serial port hardware which acts similar to standard serial port
	  hardware. If you only use the standard COM 1/2/3/4 ports, you can
	  say N here to save some memory. You can also say Y if you have an
	  "intelligent" multiport card such as Cyclades, Digiboards, etc.

config RTK_KDRV_SERIAL_8250_SHARE_IRQ
	bool "Support for sharing serial interrupts"
	depends on RTK_KDRV_SERIAL_8250_EXTENDED
	help
	  Some serial boards have hardware support which allows multiple dumb
	  serial ports on the same board to share a single IRQ. To enable
	  support for this in the serial driver, say Y here.

config RTK_KDRV_SERIAL_8250_DETECT_IRQ
	bool "Autodetect IRQ on standard ports (unsafe)"
	depends on RTK_KDRV_SERIAL_8250_EXTENDED
	help
	  Say Y here if you want the kernel to try to guess which IRQ
	  to use for your serial port.

	  This is considered unsafe; it is far better to configure the IRQ in
	  a boot script using the setserial command.

	  If unsure, say N.

config RTK_KDRV_SERIAL_8250_RSA
	bool "Support RSA serial ports"
	depends on RTK_KDRV_SERIAL_8250_EXTENDED
	help
	  ::: To be written :::

config RTK_KDRV_SERIAL_8250_UART_DMA
	bool "Uart1 DMA function support"
	depends on RTK_KDRV_SERIAL_8250 
	default n
	help
	  Uart1 DMA function support.

endmenu
```

## drivers/rtk_kdriver/usb/Kconfig
```kconfig
menu "RTK USB Kdriver"

config RTK_KDRV_USB
	bool "RTK USB driver support"
	depends on USB && RTK_KDRIVER_SUPPORT

if RTK_KDRV_USB

config RTK_KDRV_EHCI_HCD_PLATFORM
	bool "RTK EHCI HCD Platform driver"
	depends on USB_EHCI_HCD_PLATFORM
	help

config EHCI_HUB_POLLING_CHECK
	bool "ehci HUB POLLING CHECK"
	depends on RTK_KDRV_EHCI_HCD_PLATFORM
	default y
	help

endif

endmenu
```

## drivers/rtk_kdriver/vdec/Kconfig
```kconfig
config RTK_KDRV_VDEC
	bool "Driver for VDEC HAL Manager"
	depends on RTK_KDRV_RPC
	default n
	help
	  Driver for VDEC HAL Manager

config RTK_VIDEO_LOSSY_COMP_50P
        bool "Video using 50% lossy compression"
        depends on RTK_KDRV_VDEC
        default n
        help
          Select video 50% lossy compression for less VBM usage 
```

## drivers/staging/realtek/Kconfig
```kconfig
menu "REALTEK_STAGING"

config REALTEK_STAGING
	bool "Realtek Staging Drivers"
	default N
	---help---
	  Enable support for various drivers needed on the Realtek platform

if REALTEK_STAGING

config USER_INITCALL
	bool "User Initcall support"
	default y
	help
	  Support for user level initcall. This special initcall is invoked by
	  writing group name to /proc/usercalls in user space. The group name
	  is sepcified by user_initcall_grp macro in specific driver.
	  If unsure, say N.

config USER_INITCALL_USB
	bool "User Initcall usb support"
	depends on USER_INITCALL
	default y
	help
	  Apply user initcall to usb device and usb storage driver.
	  If unsure, say N.

endif # REALTEK_STAGING

endmenu
```

## drivers/usb/dwc_otg/driver/Kconfig
```kconfig
#
# Synopsys DWC OTG Controller Drivers
#

comment "DWC OTG Controller Drivers"
   
config USB_DWC_OTG
    tristate "DWC OTG support"
    depends on USB_OTG
    default n
    help
	  USB OTG Controller driver. 
	  Synopsys DeshignWare Hi-Speed USB On-The-Go (OTG) Core.
```

## fs/cramfs/Kconfig
```kconfig
config CRAMFS
	tristate "Compressed ROM file system support (cramfs) (OBSOLETE)"
	depends on BLOCK
	select ZLIB_INFLATE
	help
	  Saying Y here includes support for CramFs (Compressed ROM File
	  System).  CramFs is designed to be a simple, small, and compressed
	  file system for ROM based embedded systems.  CramFs is read-only,
	  limited to 256MB file systems (with 16MB files), and doesn't support
	  16/32 bits uid/gid, hard links and timestamps.

	  See <file:Documentation/filesystems/cramfs.txt> and
	  <file:fs/cramfs/README> for further information.

	  To compile this as a module, choose M here: the module will be called
	  cramfs.  Note that the root file system (the one containing the
	  directory /) cannot be compiled as a module.

	  This filesystem is obsoleted by SquashFS, which is much better
	  in terms of performance and features.

	  If unsure, say N.

config CRAMFS_LINEAR
	bool "Use linear addressing for CramFs"
	depends on CRAMFS
	help
	  This option tells the CramFs driver to load data directly from
	  a linear adressed memory range (usually non volatile memory
	  like flash) instead of going through the block device layer.
	  This saves some memory since no intermediate buffering is
	  necessary.

	  This is also a prerequisite for XIP of binaries stored on the
	  filesystem.

	  The location of the CramFs image in memory is board
	  dependent. Therefore, if you say Y, you must know the proper
	  physical address where to store the CramFs image and specify
	  it using the physaddr=0x******** mount option (for example:
	  "mount -t cramfs -o physaddr=0x100000 none /mnt").

	  If unsure, say N.

config CRAMFS_LINEAR_XIP
	bool "Support XIP on linear CramFs"
	depends on CRAMFS_LINEAR
	help
	  You must say Y to this option if you want to be able to run
	  applications directly from non-volatile memory.  XIP
	  applications are marked by setting the sticky bit (ie, "chmod
	  +t <app name>").  A cramfs file system then needs to be
	  created using mkcramfs (with XIP cramfs support in
	  it). Applications marked for XIP execution will not be
	  compressed since they have to run directly from flash.
```
