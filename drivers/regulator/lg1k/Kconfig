## drivers/rtk_kdriver/i2c/Kconfig
```kconfig
#
# I2C algorithm drivers configuration
#

#menu "I2C Algorithms"
menu "RTK I2C Kdriver "
	visible if !I2C_HELPER_AUTO

config RTK_KDRV_I2C_ALGO_RTK
	tristate "I2C Realtek Kdriver Algorithms interfaces"
	depends on I2C
	default n
	help
		Supports the Realtek Kdriver I2C

config RTK_KDRV_I2C
	tristate "Realtek Kdriver I2C Buses"
	depends on I2C
	select I2C_CHARDEV
	select RTK_KDRV_GPIO
	select I2C_ALGORTK_KDRV
	help
		This driver supports I2C Controller on Realtek SoC

config RTK_KDRV_I2C_BUS_JAM_RECOVER
	bool "Do recover if i2c bus is jammed"
	depends on RTK_KDRV_I2C
	default y
	help
		Say Y here if you do recover procedure if i2c bus is jammed.
		The I2c driver will detect bus status before an i2c transfer.
		If the bus is jammed, then force output 10 extra clocks
		on SCL to recover the bus jam problem.

config RTK_KDRV_I2C_NON_STOP_WRITE_XFER
	bool "Support non stop write"
	depends on RTK_KDRV_I2C
	default n
	help
		Say Y here if you want to supoort non stop write.

config RTK_KDRV_I2C_RTK_SLAVE
	tristate "Support I2C slave mode"
	depends on RTK_KDRV_I2C
	default n
	help
		Enable Realtek I2C slave function

config RTK_KDRV_I2C_HW_SEMAPHORE_SUPPORT
	tristate "Support I2C HW Semaphore Support"
	depends on RTK_KDRV_I2C
	default n
	help
		Enable Realtek I2C HW Sempaphore Support

endmenu
```

## drivers/rtk_kdriver/ir/Kconfig
```kconfig
menu "IR Receiver Driver"
config RTK_KDRV_IR
	tristate "IR Receiver Driver"
	default y
	help
		IR Receiver Character Device Driver

config RTK_KDRV_IR_MOD_KEY_TOOL
	tristate "IR Key Gen Tool"
	default n
	help
		Use to generate any irda signals by GPIO.

if RTK_KDRV_IR

config RTK_KDRV_RECORD_KEY
        bool "IR key recorder toool"
        depends on RTK_KDRV_IR && RTK_KDRV_RAW_MODE
        default n
        help
                Use for record key

config IRDA_POWER_SAVING_MODE
        bool "irda power saving function"
        depends on RTK_KDRV_IR
        default n
        help
                Used for Irda power saving

config RTK_KDRV_DYNAMIC_INPUT_DEV_NAME
        bool "support irda input dev dynamic name configure"
        depends on RTK_KDRV_IR
        default n
        help
                Used for irda input dev dynamic name configure

config DELAY_FIRST_REPEAT
	bool "IR support first repeat delay"
	depends on RTK_KDRV_IR
	default n if ANDROID
	default y if !ANDROID
	help
		IR support first repeat dealy

config RTK_KDRV_INPUT_DEVICE
	bool "Support IR Input Device"
	depends on RTK_KDRV_IR
	default y
	help
		IR Input Device Support

config RTK_KDRV_IR_SUPPORT_ANDROID_O
	bool "IR Support Android O"
	depends on RTK_KDRV_IR && ANDROID && RTK_KDRV_INPUT_DEVICE
	default n
	help
		IR Support Android O

config RTK_KDRV_SUPPORT_ALC_COMMAND
        bool "alc module enable"
        depends on RTK_KDRV_INPUT_DEVICE && RTK_KDRV_IR && ANDROID
        default n
        help
                Used for alc module function

config RTK_KDRV_INPUT_DEVICE_MOUSE
	bool "Support IR Input Device Mouse"
	depends on RTK_KDRV_IR && RTK_KDRV_INPUT_DEVICE
	default n 
	help
		IR Input Device as Mouse Support

config RTK_KDRV_RAW_MODE
	bool "Use Raw Mode decode"
	depends on RTK_KDRV_IR
	help
		Use Raw Mode decode

config RTK_KDRV_HAIER_IR
    bool "Support HAIER TV Remote Controller"
    depends on RTK_KDRV_IR
    help
       HAIER TV Remote Controller
 
config RTK_KDRV_YK_54LU
    bool "Support Skyworth TV Remote Controller"
    depends on RTK_KDRV_IR
    help
      Skyworth TV Remote Controller

if RTK_KDRV_YK_54LU
config RTK_KDRV_YK_54LU_SHUTTLE
	bool "Support Skyworth shuttle device"
	depends on RTK_KDRV_YK_54LU && RTK_KDRV_RAW_MODE
	help
		Skyworth shuttle Device
endif

config RTK_KDRV_MK5_2
    bool "Support Realtek DTV Controller"
    depends on RTK_KDRV_IR
    help
      Realtek DTV Remote Controller

config RTK_KDRV_TV001_IR
    bool "Support Realtek Keycode Mapping"
    depends on RTK_KDRV_IR && RTK_KDRV_INPUT_DEVICE
    default y if RTK_KDRV_MK5_2
    help
      Realtek DTV Keycode Mapping

config RTK_KDRV_TV002_IR_RAW_MODE
	bool "Support SONY Remote Controller Raw Mode Decode"
	depends on RTK_KDRV_RAW_MODE
	help
		SONY Remote Controller

config RTK_KDRV_TV002_IR
    bool "Support Sony Keycode Mapping"
    depends on RTK_KDRV_IR && RTK_KDRV_INPUT_DEVICE
    default y if RTK_KDRV_TV002_IR_RAW_MODE
    help
      Realtek Sony Keycode Mapping

config RTK_KDRV_ANDROID_OTT
    bool "Support Realtek android stb OTT Controller"
    depends on RTK_KDRV_IR
    help
      Realtek OTT Remote Controller

config RTK_KDRV_TV015_IR
    bool "Support TPV DTV Controller"
    depends on RTK_KDRV_IR
    help
      TPV DTV Remote Controller

config RTK_KDRV_TV030_IR
    bool "Support TCL DTV Controller"
    depends on RTK_KDRV_IR && RTK_KDRV_RAW_MODE
    help
      TCL DTV Remote Controller

if RTK_KDRV_TV030_IR
config RTK_KDRV_TV030_MOUSE
	bool "Support TCL mouse device"
	depends on RTK_KDRV_TV030_IR && RTK_KDRV_RAW_MODE && RTK_KDRV_INPUT_DEVICE
	help
		TCL Mouse Device
endif

config RTK_KDRV_TV035_IR
    bool "Support KONKA TV Remote Controller"
    depends on RTK_KDRV_IR && RTK_KDRV_RAW_MODE
    help
      KONKA TV Remote Controller

if TV035_IR
config RTK_KDRV_TV035_IR_RAW_MODE
    bool "Support KONKA TV Remote Controller Raw Mode Decode"
    depends on RTK_KDRV_TV035_IR && RTK_KDRV_RAW_MODE
    help
      KONKA TV Remote Controller Raw Mode Decode
endif

config RTK_KDRV_TV036_10D_IR
    bool "Support HIKEEN 10D TV Remote Controller"
    depends on RTK_KDRV_IR
    help
      HIKEEN 10D TV Remote Controller

config RTK_KDRV_TV036_KTSG45_IR
    bool "Support HIKEEN KTSG45 TV Remote Controller"
    depends on RTK_KDRV_IR && RTK_KDRV_RAW_MODE
    help
      HIKEEN KTSG45 TV Remote Controller

config RTK_KDRV_TV005_IR
	bool "Support Toshiba Android DTV Controller"
	depends on RTK_KDRV_IR
	help
      		Toshiba Android DTV Remote Controller

if RTK_KDRV_TV005_IR
config RTK_KDRV_TV005_MOUSE
	bool "Support Toshiba mouse pointing device"
	depends on RTK_KDRV_TV005_IR && RTK_KDRV_RAW_MODE && RTK_KDRV_INPUT_DEVICE_MOUSE
	help
		Toshiba Mouse Pointing Device
endif

endif

endmenu # endof RTK_KDRV_IR
```

## drivers/rtk_kdriver/mcp/Kconfig
```kconfig
menu "MCP HW Crypto Engine Support"

# CP
config RTK_KDRV_MCP
        bool "MCP Driver."
        depends on RTK_KDRIVER_SUPPORT
        select RTK_KDRIVER
        default n

config RTK_KDRV_RCP_TEST
        bool "Support CP Register Mode Cryption Self Test"
        depends on RTK_KDRV_MCP
        default n
        help
          CP Register mode Driver Self Test 

config RTK_KDRV_MCP_NAPI
        bool "MCP New API"
        depends on RTK_KDRV_MCP
        default n
        help
          MCP New API Driver

config RTK_KDRV_MCP_SHA256
        bool "Support MCP SHA256"
        depends on RTK_KDRV_MCP
        default n
        help
          MCP SHA256 Driver

config RTK_KDRV_MCP_RSA
	bool "Support MCP RSA"
	select MPILIB
	default n
	help
          MCP RSA Driver

config RTK_KDRV_MCP_CAMELLIA
        bool "Support MCP Camellia Algorithm"
        depends on RTK_KDRV_MCP
        default n
        help
          MCP CAMELLIA Driver
endmenu
```

## drivers/rtk_kdriver/omx/Kconfig
```kconfig
config RTK_KDRV_OMX
	tristate "Driver for OpenMAX Integration Layer"
	default n
	depends on RTK_KDRV_RPC
	help
	  Driver for OpenMAX Integration Layer
```

## drivers/rtk_kdriver/pcbmgr/Kconfig
```kconfig
#Note: disable it since the following config is already defined in mach-rtd284x/Kconfig

#config REALTEK_PCBMGR
#	bool "Use Realtek PCB Manager sysfs"
#	default n
#	help
#		pcb manager enable, pcb manager will export the pcb info at /sys/realtek_boards/pcb_enum
#
config REALTEK_PCBMGR_WITH_IO_API
	bool 
	depends on REALTEK_PCBMGR
	select RTK_KDRV_GPIO
	default y
```

## drivers/rtk_kdriver/rtice/Kconfig
```kconfig
menu "Realtek RTICE stub" 

config RTK_KDRV_RTICE
	bool "Use Realtek RTICE stub driver"
	depends on RTK_KDRIVER_SUPPORT	
	default n
	help
		RTICE stub driver
		
#=================================================================
		
config RTK_KDRV_RTICE_SYSTEM_TOOL
        bool "RTICE System Utilities"
        depends on RTK_KDRV_RTICE
        default y
        help
          RTICE System utility allows user to access system infomation
 
config RTK_KDRV_RTICE_IOMEM_TOOL
        bool "RTICE IO/MEM Utilities"
        depends on RTK_KDRV_RTICE
        default y
        help
          RTICE IO/MEM utility allows user to access io/mem 
          
config RTK_KDRV_RTICE_I2C_TOOL
        bool "RTICE I2C Tool driver"
        depends on RTK_KDRV_RTICE && I2C
        default y
        help
          RTICE I2C Tool allows user to access i2c via RTICE
          
config RTK_KDRV_RTICE_ICM_TOOL
        bool "RTICE ICM (Independent Clock Management) Tool"
        depends on RTK_KDRV_RTICE && MACH_RTK_294x
        default n
        help
          RTICE ICM Tool driver

config RTK_KDRV_RTICE_AP_TOOL
        bool "RTICE AP DEBUG Tool driver"
        depends on RTK_KDRV_RTICE
        default y
        help
          RTICE AP DEBUG Tool allows user to access ap ID value
	  
config RTK_KDRV_RTICE_BW_CHECK
        bool "RTICE BW Check Tool driver"
        depends on RTK_KDRV_RTICE
        default y
        help
          RTICE BW Check Tool allows user to start bw checking flow and query bw value of checked ip. 		

config RTK_KDRV_RTICE_DMA_STATUS
        tristate "RTICE2 DMA Status Tool driver"
        depends on RTK_KDRV_RTICE
        default y
        help
          RTICE DMA Status Tool allows user to query info about DMA of checked ip.
 
config RTK_KDRV_RTICE_MC_MEASURE
        tristate "RTICE MC Measure Tool driver"
        depends on RTK_KDRV_RTICE
        default y
        help
          RTICE MC Measure Tool allows user to query info about MC read or write count.
          
endmenu
```
